## main/Kconfig.projbuild
```kconfig
menu "Echo RS485 Example Configuration"

    orsource "$IDF_PATH/examples/common_components/env_caps/$IDF_TARGET/Kconfig.env_caps"

    config ECHO_UART_PORT_NUM
        int "UART port number"
        range 0 2 if IDF_TARGET_ESP32 || IDF_TARGET_ESP32S3
        default 2 if IDF_TARGET_ESP32 || IDF_TARGET_ESP32S3
        range 0 1
        default 1
        help
            UART communication port number for the example.
            See UART documentation for available port numbers.

    config ECHO_UART_BAUD_RATE
        int "UART communication speed"
        range 1200 4000000
        default 4000000
        help
            UART communication speed for RS485 example. Support up to 4Mbps for high-speed communication.

    config ECHO_UART_RXD
        int "UART RXD pin number"
        range ENV_GPIO_RANGE_MIN ENV_GPIO_IN_RANGE_MAX
        default 2
        help
            GPIO number for UART RX pin. Set to GPIO2 for high-speed RS485 with MAX13487.
            See UART documentation for more information about available pin numbers for UART.

    config ECHO_UART_TXD
        int "UART TXD pin number"
        range ENV_GPIO_RANGE_MIN ENV_GPIO_OUT_RANGE_MAX
        default 1
        help
            GPIO number for UART TX pin. Set to GPIO1 for high-speed RS485 with MAX13487.
            See UART documentation for more information about available pin numbers for UART.

    config ECHO_UART_RTS
        int "UART RTS pin number"
        range ENV_GPIO_RANGE_MIN ENV_GPIO_OUT_RANGE_MAX
        default 3
        help
            GPIO number for UART RTS pin. Set to GPIO3 for MAX13487 DE/RE control.
            This pin is connected to ~RE/DE pin of RS485 transceiver to switch direction.
            See UART documentation for more information about available pin
            numbers for UART.

    config ECHO_TASK_STACK_SIZE
        int "UART echo RS485 example task stack size"
        range 1024 16384
        default 3072
        help
            Defines stack size for UART echo RS485 example. Insufficient stack size can cause crash.

endmenu
```
